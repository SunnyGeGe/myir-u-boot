## arch/arm/cpu/armv7/omap5/Kconfig
```kconfig
if OMAP54XX

choice
	prompt "OMAP5 board select"
	optional

config TARGET_CM_T54
	bool "CompuLab CM-T54"

config TARGET_OMAP5_UEVM
	bool "TI OMAP5 uEVM board"

config TARGET_DRA7XX_EVM
	bool "TI DRA7XX"
	select TI_I2C_BOARD_DETECT

config TARGET_AM57XX_EVM
	bool "AM57XX"
	select TI_I2C_BOARD_DETECT

endchoice

config SYS_SOC
	default "omap5"

source "board/compulab/cm_t54/Kconfig"
source "board/ti/omap5_uevm/Kconfig"
source "board/ti/dra7xx/Kconfig"
source "board/ti/am57xx/Kconfig"

if TARGET_DRA7XX_EVM || TARGET_AM57XX_EVM
menu "Voltage Domain OPP selections"

choice
	prompt "MPU Voltage Domain"
	default DRA7_MPU_OPP_NOM
        help
	  Select the OPP for the MPU voltage domain on DRA7xx & AM57xx SoCs

config DRA7_MPU_OPP_NOM
	bool "OPP NOM"

endchoice

choice
	prompt "DSPEVE Voltage Domain"
        help
	  Select the OPP for the DSPEVE voltage domain on DRA7xx and AM57xx SoCs

config DRA7_DSPEVE_OPP_NOM
	bool "OPP NOM"

config DRA7_DSPEVE_OPP_OD
	bool "OPP OD"

config DRA7_DSPEVE_OPP_HIGH
	bool "OPP HIGH"

endchoice

choice
	prompt "IVA Voltage Domain"
        help
	  Select the OPP for the IVA voltage domain on DRA7xx and AM57xx SoCs

config DRA7_IVA_OPP_NOM
	bool "OPP NOM"

config DRA7_IVA_OPP_OD
	bool "OPP OD"

config DRA7_IVA_OPP_HIGH
	bool "OPP HIGH"

endchoice

choice
	prompt "GPU Voltage Domain"
        help
	  Select the OPP for the GPU voltage domain on DRA7xx and AM57xx SoCs

config DRA7_GPU_OPP_NOM
	bool "OPP NOM"

config DRA7_GPU_OPP_OD
	bool "OPP OD"

config DRA7_GPU_OPP_HIGH
	bool "OPP HIGH"

endchoice

endmenu
endif

endif
```

## board/myirtech/common/Kconfig
```kconfig
config MYIR_I2C_BOARD_DETECT
	bool "Support for Board detection for MYIR platforms"
	help
	   Support for detection board information on MYIRTECH's
	   Evaluation Boards which have I2C based EEPROM detection

config MYIR_OLD_UBOOT
	bool "Be Compatible with old u-boot 2011.09"
	help 
	   Support for booting legacy uImage of kernel 3.2.0

config MYIR_NAND_8G08
	bool "Support for 8G08 Nand Flash"
	depends on !MYIR_OLD_UBOOT
	help 
	   Support for 8G08 Nand Flash with the pagesize 4096

config MYIR_UBOOT_BACKUP
	bool "Support u-boot and kernel backup partitions myir dev boards"
	depends on (!MYIR_OLD_UBOOT) && (!MYIR_NAND_8G08)
	help 
	   Backup and restore u-boot and legacy uImage
```

## board/myirtech/myd_c437x/Kconfig
```kconfig
if TARGET_MYD_C437X

config SYS_BOARD
	default "myd_c437x"

config SYS_VENDOR
	default "myirtech"

config SYS_SOC
	default "am33xx"

config SYS_CONFIG_NAME
	default "myd_c437x"
config MYIR_BORAD_NAME
	string "myir board name"
	depends on TARGET_MYD_C437X
source "board/myirtech/common/Kconfig"

endif
```

## board/myirtech/ricoboard/Kconfig
```kconfig
if TARGET_RICOBOARD

config SYS_BOARD
	default "ricoboard"

config SYS_VENDOR
	default "myirtech"

config SYS_SOC
	default "am33xx"

config SYS_CONFIG_NAME
	default "ricoboard"

source "board/myirtech/common/Kconfig"

endif
```

## configs/am335x_evm_defconfig
```kconfig
CONFIG_ARM=y
CONFIG_TARGET_AM335X_EVM=y
CONFIG_SPL_STACK_R_ADDR=0x82000000
CONFIG_DEFAULT_DEVICE_TREE="am335x-evm"
CONFIG_SPL=y
CONFIG_SPL_STACK_R=y
CONFIG_SYS_EXTRA_OPTIONS="NAND"
CONFIG_AUTOBOOT_KEYED=y
CONFIG_AUTOBOOT_PROMPT="Press SPACE to abort autoboot in %d seconds\n"
CONFIG_AUTOBOOT_DELAY_STR="d"
CONFIG_AUTOBOOT_STOP_STR=" "
# CONFIG_CMD_IMLS is not set
# CONFIG_CMD_FLASH is not set
CONFIG_CMD_GPIO=y
# CONFIG_CMD_SETEXPR is not set
CONFIG_OF_CONTROL=y
CONFIG_DM_MMC=y
CONFIG_SPI_FLASH=y
CONFIG_SPI_FLASH_WINBOND=y
CONFIG_DM_ETH=y
CONFIG_SYS_NS16550=y
CONFIG_TIMER=y
CONFIG_OMAP_TIMER=y
CONFIG_USB=y
CONFIG_USB_GADGET=y
CONFIG_RSA=y
CONFIG_FIT=y
CONFIG_SPL_OF_LIBFDT=y
CONFIG_SPL_LOAD_FIT=y
CONFIG_OF_LIST="am335x-evm am335x-bone am335x-boneblack am335x-evmsk am335x-bonegreen"
```

## configs/myd_j335x_defconfig
```kconfig
CONFIG_ARM=y
CONFIG_TARGET_MYD_J335X=y
CONFIG_SPL_STACK_R_ADDR=0x82000000
CONFIG_DEFAULT_DEVICE_TREE="myd_j335x"
CONFIG_SPL=y
CONFIG_SPL_STACK_R=y
CONFIG_SYS_EXTRA_OPTIONS="NAND,ENV_IS_IN_NAND"
CONFIG_HUSH_PARSER=y
CONFIG_AUTOBOOT_KEYED=y
CONFIG_AUTOBOOT_PROMPT="Press SPACE to abort autoboot in %d seconds\n"
CONFIG_AUTOBOOT_DELAY_STR="d"
CONFIG_AUTOBOOT_STOP_STR=" "
CONFIG_CMD_BOOTZ=y
CONFIG_SYS_PROMPT="MYIR># "
# CONFIG_CMD_IMLS is not set
CONFIG_CMD_ASKENV=y
# CONFIG_CMD_FLASH is not set
CONFIG_CMD_MMC=y
CONFIG_CMD_I2C=y
CONFIG_CMD_GPIO=y
# CONFIG_CMD_SETEXPR is not set
CONFIG_CMD_DHCP=y
CONFIG_CMD_MII=y
CONFIG_CMD_PING=y
CONFIG_CMD_EXT2=y
CONFIG_CMD_EXT4=y
CONFIG_CMD_EXT4_WRITE=y
CONFIG_CMD_FAT=y
CONFIG_CMD_FS_GENERIC=y
CONFIG_SYS_NS16550=y
CONFIG_OF_LIBFDT=y
```

## configs/myd_j335x_emmc_defconfig
```kconfig
CONFIG_ARM=y
CONFIG_TARGET_MYD_J335X=y
CONFIG_SPL_STACK_R_ADDR=0x82000000
CONFIG_DEFAULT_DEVICE_TREE="myd_j335x"
CONFIG_SPL=y
CONFIG_SPL_STACK_R=y
CONFIG_SYS_EXTRA_OPTIONS="SERIAL1,CONS_INDEX=1"
CONFIG_HUSH_PARSER=y
CONFIG_AUTOBOOT_KEYED=y
CONFIG_AUTOBOOT_PROMPT="Press SPACE to abort autoboot in %d seconds\n"
CONFIG_AUTOBOOT_DELAY_STR="d"
CONFIG_AUTOBOOT_STOP_STR=" "
CONFIG_CMD_BOOTZ=y
CONFIG_SYS_PROMPT="MYIR># "
# CONFIG_CMD_IMLS is not set
CONFIG_CMD_ASKENV=y
# CONFIG_CMD_FLASH is not set
CONFIG_CMD_MMC=y
CONFIG_CMD_I2C=y
CONFIG_CMD_USB=y
CONFIG_CMD_GPIO=y
# CONFIG_CMD_SETEXPR is not set
CONFIG_CMD_DHCP=y
CONFIG_CMD_MII=y
CONFIG_CMD_PING=y
CONFIG_CMD_EXT2=y
CONFIG_CMD_EXT4=y
CONFIG_CMD_EXT4_WRITE=y
CONFIG_CMD_FAT=y
CONFIG_CMD_FS_GENERIC=y
CONFIG_SYS_NS16550=y
CONFIG_OMAP_TIMER=y
CONFIG_USB=y
CONFIG_USB_MUSB_HOST=y
CONFIG_USB_MUSB_GADGET=y
CONFIG_USB_GADGET=y
CONFIG_RSA=y
CONFIG_OF_LIBFDT=y
CONFIG_OF_LIST="myd_j335x"
CONFIG_USB_GADGET_DOWNLOAD=y
CONFIG_G_DNL_MANUFACTURER="Texas Instruments"
CONFIG_G_DNL_VENDOR_NUM=0x0451
CONFIG_G_DNL_PRODUCT_NUM=0xd022
CONFIG_MISC=y
CONFIG_USB_MUSB_TI=y
CONFIG_OF_BOARD_SETUP=y
```
